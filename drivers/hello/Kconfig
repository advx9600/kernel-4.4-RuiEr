## drivers/hello/Kconfig
```kconfig
 config HELLO
           tristate "First Test Android Driver Hello "
           default n
           help
           This is the first android driver.
```

## drivers/net/wireless/bcmdhd/Kconfig
```kconfig
config BCMDHD
	bool "Broadcom 4329/30 wireless cards support"
	depends on MMC
	---help---
	  This module adds support for wireless adapters based on
	  Broadcom 4329/30 chipset.

config BCMDHD_FW_PATH
	depends on BCMDHD
	string "Firmware path"
	default "/system/etc/firmware/fw_bcmdhd.bin"
	---help---
	  Path to the firmware file.

config BCMDHD_NVRAM_PATH
	depends on BCMDHD
	string "NVRAM path"
	default "/system/etc/firmware/nvram.txt"
	---help---
	  Path to the calibration file.

config BCMDHD_CONFIG_PATH
	depends on BCMDHD
	string "Config path"
	default "/system/etc/firmware/config.txt"
	---help---
	  Path to the driver configuration file.

config BCMDHD_WEXT
	bool "Enable WEXT support"
	depends on BCMDHD && CFG80211 = n
	select WIRELESS_EXT
	select WEXT_PRIV
	help
	  Enables WEXT support
config WIFI_CONTROL_FUNC
    depends on BCMDHD
    bool "Enables wifi function"
    ---help---
      Use control of wifi function
```
